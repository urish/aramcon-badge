## CMakeLists.txt
```
# Boilerplate code, which pulls in the Zephyr build system.
cmake_minimum_required(VERSION 3.13.1)
include($ENV{ZEPHYR_BASE}/cmake/app/boilerplate.cmake NO_POLICY_SCOPE)
project(badge_app)

# Add your source file to the "app" target. This must come after
# the boilerplate code, which defines the target.
target_sources(app PRIVATE src/main.c)
target_sources(app PRIVATE src/drivers/led.c)
target_sources(app PRIVATE src/drivers/buttons.c)
target_sources(app PRIVATE src/drivers/vibration_motor.c)
target_sources(app PRIVATE src/drivers/neopixels.c)
target_sources(app PRIVATE src/drivers/display.c)
target_sources(app PRIVATE src/drivers/battery_voltage.c)
target_sources(app PRIVATE src/drivers/sound.c)
target_sources(app PRIVATE src/ble_service.c)
```

## prj.conf
```kconfig
CONFIG_GPIO=y
CONFIG_SERIAL=y
CONFIG_LOG=y

CONFIG_HAS_SEGGER_RTT=y
CONFIG_USE_SEGGER_RTT=y
CONFIG_RTT_CONSOLE=y

CONFIG_USB=y
CONFIG_USB_DEVICE_STACK=y
CONFIG_USB_DEVICE_PRODUCT="Badge Console"
#CONFIG_USB_UART_CONSOLE=y
CONFIG_UART_INTERRUPT_DRIVEN=y
CONFIG_UART_LINE_CTRL=y
CONFIG_USB_DEVICE_VID=0x2FE3
CONFIG_USB_DEVICE_PID=0x100
CONFIG_USB_DEVICE_MANUFACTURER="ARAMCON"
CONFIG_USB_DEVICE_PRODUCT="BADGE"
CONFIG_USB_DEVICE_SN="1.00"

CONFIG_BT=y
CONFIG_BT_DEBUG_LOG=y
CONFIG_BT_SMP=y
CONFIG_BT_PERIPHERAL=y
CONFIG_BT_GATT_DIS=y
CONFIG_BT_DEVICE_NAME="Badge"

CONFIG_SPI=y
CONFIG_SPI_NRFX=y
CONFIG_SPI_0=y
CONFIG_SPI_0_NRF_SPIM=y
CONFIG_SPI_1=y
CONFIG_SPI_1_NRF_SPIM=y

CONFIG_LED_STRIP=y
CONFIG_WS2812_STRIP=y
CONFIG_WS2812_HAS_WHITE_CHANNEL=n

# Display
CONFIG_DISPLAY=y
CONFIG_CHARACTER_FRAMEBUFFER=y
CONFIG_HEAP_MEM_POOL_SIZE=16384
CONFIG_SSD1673=y

# ADC
CONFIG_ADC=y
CONFIG_ADC_0=y
CONFIG_ADC_NRFX_ADC=y
```

## src/main.c
```c
/*
 * Badge Hardware Test App
 * Author: Uri Shaked
 *
 * SPDX-License-Identifier: Apache-2.0
 */

#include <errno.h>
#include <string.h>

#define LOG_LEVEL 4
#include <logging/log.h>
LOG_MODULE_REGISTER(main);

#include <zephyr.h>

#include <device.h>
#include <gpio.h>
#include <stdio.h>
#include <misc/util.h>

#include "drivers/led.h"
#include "drivers/buttons.h"
#include "drivers/vibration_motor.h"
#include "drivers/neopixels.h"
#include "drivers/display.h"
#include "drivers/battery_voltage.h"
#include "drivers/sound.h"
#include "ble_service.h"

#define SLEEP_TIME 500

static u32_t button_val[BUTTON_COUNT] = {};

static uint16_t counter = 0;
static char *sound_result = NULL;

void init_drivers()
{
	init_led();
	init_buttons();
	init_vibration_motor();
	init_neopixels();
	init_display();
	init_battery_voltage();
	init_sound();
}

void read_inputs()
{
	for (u32_t i = 0; i < BUTTON_COUNT; ++i)
	{
		button_read(i, &button_val[i]);
	}

	sample_battery_voltage();

	if (!sound_result)
	{
		sound_result = sound_sanity() ? "PASS" : "FAIL!!!";
	}
}

void update_neopixels()
{
	if (counter % 2)
	{
		write_neopixel(0, red);
		write_neopixel(1, green);
		write_neopixel(2, purple);
		write_neopixel(3, blue);
	}
	else
	{
		write_neopixel(0, green);
		write_neopixel(1, red);
		write_neopixel(2, blue);
		write_neopixel(3, purple);
	}
}

void update_display()
{
	char buf[64];
	clear_display();
	print_line_to_display(0, "*** Badge Self-Test ***");

	sprintf(buf, "Battery: %.2fv", read_battery_voltage());
	print_line_to_display(1, buf);

	sprintf(buf, "Sound: %s", sound_result ? sound_result : "Testing...");
	print_line_to_display(4, buf);

	sprintf(buf, "BTNs L:%d M:%d R:%d", !button_val[2], !button_val[1], !button_val[0]);
	print_line_to_display(5, buf);

	if (ble_service_is_ready())
	{
		sprintf(buf, "Name: %s", get_ble_name());
		print_line_to_display(2, buf);

		const char *mac = get_ble_mac();
		const char *remote_mac = get_ble_remote_mac();
		if (remote_mac)
		{
			sprintf(buf, "Connected! %s", remote_mac);
			print_line_to_display(3, buf);
		}
		else if (mac)
		{
			sprintf(buf, "Mac:  %s", mac);
			print_line_to_display(3, buf);
		}
	}

	// TODO display Flash status
	// TODO display accelerometer status (LIS2DH driver)

	char *status = "\\|/-";
	sprintf(buf, "%c", status[counter % sizeof(status)]);
	print_line_to_display(6, buf);
}

void update_state()
{
	update_neopixels();
	update_display();
}

void write_outputs()
{
	// Control the vibrator, based on middle button
	write_vibration_motor(!button_val[1]);
	write_led(counter % 2);
	flush_neopixels();
	flush_display();
}

void main(void)
{
	LOG_INF("Starting app...\n");

	init_drivers();
	init_ble_service();

	while (1)
	{
		read_inputs();
		update_state();
		write_outputs();
		k_sleep(SLEEP_TIME);
		counter++;
	}
}
```

## src/ble_service.h
```c
#ifndef __BLE_SERVICE_H__
#define __BLE_SERVICE_H__
#include <zephyr.h>

void init_ble_service();

const char *get_ble_name();

const char* get_ble_mac();

const char* get_ble_remote_mac();

bool ble_service_is_ready();





#endif // __BLE_SERVICE_H__
```

## src/buttons.c
```c
#include "buttons.h"
#include <device.h>
#include <gpio.h>

static struct device *gpio_bindings[BUTTON_COUNT]  = {};
static const u32_t button_pin_map[BUTTON_COUNT] = {SW0_GPIO_PIN, SW1_GPIO_PIN, SW2_GPIO_PIN};
static const const char *button_port_map[BUTTON_COUNT] = {SW0_GPIO_CONTROLLER, SW1_GPIO_CONTROLLER, SW2_GPIO_CONTROLLER};
void init_buttons()
{
    for (u32_t i = 0; i < BUTTON_COUNT; ++i)
    {
        gpio_bindings[i] = device_get_binding(button_port_map[i]);
        gpio_pin_configure(gpio_bindings[i], button_pin_map[i],	GPIO_DIR_IN |  SW0_GPIO_FLAGS);
    }
}

void button_read(u32_t button_number, u32_t *value)
{
    if (button_number < 3) {
        gpio_pin_read(
            gpio_bindings[button_number],
            button_pin_map[button_number],
            value);
    }
}
```

## src/led.c
```c
#include "led.h"
#include <device.h>
#include <gpio.h>

struct device *gpio = NULL;

void init_led()
{
    gpio = device_get_binding(LED0_GPIO_CONTROLLER);
	gpio_pin_configure(gpio, LED0_GPIO_PIN, GPIO_DIR_OUT);
}

void write_led(u32_t value)
{
    gpio_pin_write(gpio, LED0_GPIO_PIN, value);
}
```
