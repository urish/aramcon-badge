## zephyr/boards/arm/badge/Kconfig
```kconfig
# Kconfig - nRF52840 BADGE board configuration
#
# Copyright (c) 2018 Nordic Semiconductor ASA
#
# SPDX-License-Identifier: Apache-2.0

if BOARD_BADGE

config BOARD_ENABLE_DCDC
        bool "Enable DCDC mode"
        select SOC_DCDC_NRF52X
        default n

config BOARD_HAS_NRF5_BOOTLOADER
	bool "Board has nRF5 bootloader"
	default n
	help
	 If selected, applications are linked so that they can be loaded by
	 Nordic nRF5 bootloader.

endif # BOARD_BADGE
```
