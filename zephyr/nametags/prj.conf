## CMakeLists.txt
```
# Boilerplate code, which pulls in the Zephyr build system.
cmake_minimum_required(VERSION 3.13.1)
include($ENV{ZEPHYR_BASE}/cmake/app/boilerplate.cmake NO_POLICY_SCOPE)
project(badge_app)

# Add your source file to the "app" target. This must come after
# the boilerplate code, which defines the target.
target_sources(app PRIVATE src/main.c)
target_sources(app PRIVATE src/colorgame.c)
target_sources(app PRIVATE src/qrcode.c)
target_sources(app PRIVATE src/agenda.c)
target_sources(app PRIVATE src/scanner.c)
target_sources(app PRIVATE src/drivers/battery_voltage.c)
target_sources(app PRIVATE src/drivers/buttons.c)
target_sources(app PRIVATE src/drivers/led.c)
target_sources(app PRIVATE src/drivers/neopixels.c)
target_sources(app PRIVATE src/drivers/vibration_motor.c)
```

## prj.conf
```kconfig
CONFIG_BOARD_HAS_NRF5_BOOTLOADER=y
CONFIG_GPIO=y
CONFIG_PWM=y
CONFIG_PWM_1=y
CONFIG_SERIAL=y
CONFIG_LOG=y

CONFIG_HAS_SEGGER_RTT=y
CONFIG_USE_SEGGER_RTT=y
CONFIG_RTT_CONSOLE=y

CONFIG_USB=y
CONFIG_USB_DEVICE_STACK=y
CONFIG_USB_DEVICE_PRODUCT="Badge Console"
#CONFIG_USB_UART_CONSOLE=y
CONFIG_UART_INTERRUPT_DRIVEN=y
CONFIG_UART_LINE_CTRL=y
CONFIG_USB_DEVICE_VID=0x2FE3
CONFIG_USB_DEVICE_PID=0x100
CONFIG_USB_DEVICE_MANUFACTURER="ARAMCON"
CONFIG_USB_DEVICE_PRODUCT="BADGE"
CONFIG_USB_DEVICE_SN="1.00"

CONFIG_BT=y
CONFIG_BT_DEBUG_LOG=y
CONFIG_BT_SMP=y
CONFIG_BT_PERIPHERAL=y
CONFIG_BT_GATT_DIS=y
CONFIG_BT_DEVICE_NAME="Badge"
CONFIG_BT_DEVICE_NAME_DYNAMIC=y
CONFIG_BT_OBSERVER=y

CONFIG_SPI=y
CONFIG_SPI_NRFX=y
CONFIG_SPI_0=y
CONFIG_SPI_0_NRF_SPIM=y
CONFIG_SPI_1=y
CONFIG_SPI_1_NRF_SPIM=y

CONFIG_LED_STRIP=y
CONFIG_WS2812_STRIP=y
CONFIG_WS2812_HAS_WHITE_CHANNEL=n

# Display
CONFIG_DISPLAY=y
CONFIG_CHARACTER_FRAMEBUFFER=y
CONFIG_HEAP_MEM_POOL_SIZE=16384
CONFIG_IL0373=y

# ADC
CONFIG_ADC=y
CONFIG_ADC_0=y
CONFIG_ADC_NRFX_ADC=y

# NVS
CONFIG_FLASH=y
CONFIG_FLASH_PAGE_LAYOUT=y
CONFIG_NVS=y
CONFIG_MPU_ALLOW_FLASH_WRITE=y
```

## src/main.c
```c
/*
 * Badge Hardware Test App
 * Author: Uri Shaked
 *
 * SPDX-License-Identifier: Apache-2.0
 */

#include <errno.h>
#include <string.h>

#define LOG_LEVEL 4
#include <logging/log.h>
LOG_MODULE_REGISTER(main);

#include <zephyr.h>
#include <device.h>
#include <gpio.h>
#include <stdio.h>
#include <display/cfb.h>
#include <misc/util.h>
#include <flash.h>
#include <nvs/nvs.h>

#include <bluetooth/bluetooth.h>
#include <bluetooth/hci.h>
#include <bluetooth/conn.h>
#include <bluetooth/uuid.h>
#include <bluetooth/gatt.h>

#include "drivers/battery_voltage.h"
#include "drivers/buttons.h"
#include "drivers/led.h"
#include "drivers/neopixels.h"
#include "drivers/sound.h"
#include "drivers/vibration_motor.h"
#include "agenda.h"
#include "colorgame.h"
#include "qrcode.h"
#include "scanner.h"
#include "logo.h"

#define SLEEP_TIME 	500

#define DISPLAY_DRIVER		"DISPLAY"

#define BT_UUID_DISP       BT_UUID_DECLARE_16(0xfeef)
#define BT_UUID_DISP_DATA  BT_UUID_DECLARE_16(0xfeee)

#define BT_UUID_BATT_VOLTAGE BT_UUID_DECLARE_128(0x9a, 0x24, 0xd0, 0xc6, 0xb0, 0x1f, 0x44, 0x4d, 0x85, 0xff, 0x59, 0x12, 0x13, 0x41, 0xad, 0x34)

#define DISPLAY_WIDTH 296
#define DISPLAY_HEIGHT 128

#define DISPLAY_ID 2
#define DISPLAY2_ID 3

struct device *display;
static bool bluetooth_ready = false;
static bool display_set = false;
static const bt_addr_le_t *remote_device = NULL;


static const struct display_buffer_descriptor desc = {
.buf_size = DISPLAY_WIDTH * DISPLAY_HEIGHT / 8,
.width = DISPLAY_WIDTH,
.height = DISPLAY_HEIGHT,
.pitch = DISPLAY_WIDTH,
};

static bool is_advertising = false;
static bool sound_sanity_result = false;
static struct nvs_fs fs;

void init_storage()
{
	int rc = 0;
	struct flash_pages_info info;
  fs.offset = DT_FLASH_AREA_STORAGE_OFFSET;
	rc = flash_get_page_info_by_offs(device_get_binding(DT_FLASH_DEV_NAME),
					 fs.offset, &info);
	if (rc) {
		LOG_ERR("Unable to get page info");
	}
	fs.sector_size = info.size;
	fs.sector_count = 3U;

	rc = nvs_init(&fs, DT_FLASH_DEV_NAME);
	if (rc) {
		LOG_ERR("Flash Init failed\n");
	}
}

static char *bluetooth_mac_to_str(const bt_addr_le_t* addr) {
	static char buf[BT_ADDR_LE_STR_LEN];
	bt_addr_le_to_str(addr, buf, sizeof(buf));
	char *space = strchr(buf, ' ');
	if (space) {
		*space = 0;
	}
	return buf;
}

void update_display() {
	char buf[64];
	cfb_framebuffer_clear(display, true);
	cfb_print(display, "*** Badge READY! ***", 0, 0);
	sprintf(buf, "Sound sanity: %s", (sound_sanity_result ? "True" : "False"));
	cfb_print(display, buf, 0, 16);
	if (bluetooth_ready) {
		sprintf(buf, "Name: %s", bt_get_name());
		cfb_print(display, buf, 0, 32);

		bt_addr_le_t addr;
		size_t count = 1;
		bt_id_get(&addr, &count);
		if (count) {
			sprintf(buf, "Mac:  %s", bluetooth_mac_to_str(&addr));
			cfb_print(display, buf, 0, 48);
		}

		if (remote_device) {
			sprintf(buf, "Connected! %s", bluetooth_mac_to_str(remote_device));
			cfb_print(display, buf, 0, 80);
		}
	}

	cfb_framebuffer_finalize(display);
}

/* Bluetooth */
static const struct bt_data ad[] = {
	BT_DATA_BYTES(BT_DATA_FLAGS, (BT_LE_AD_GENERAL | BT_LE_AD_NO_BREDR)),
  BT_DATA_BYTES(BT_DATA_UUID16_ALL, 0xef, 0xfe),
};

static void connected(struct bt_conn *conn, u8_t err) {
	if (err) {
		LOG_ERR("Failed to connect to %s (%u)\n", bluetooth_mac_to_str(bt_conn_get_dst(conn)), err);
		return;
	}

	remote_device = bt_conn_get_dst(conn);
	LOG_INF("Connected %s\n", bluetooth_mac_to_str(remote_device));

  update_display();
}

u8_t display_buf[5000] = {0};
bool display_dirty = false;

static void disconnected(struct bt_conn *conn, u8_t reason) {
	LOG_INF("Disconnected from %s (reason %u)\n", bluetooth_mac_to_str(remote_device), reason);
	remote_device = NULL;
	nvs_delete(&fs, DISPLAY_ID);
	nvs_delete(&fs, DISPLAY2_ID);
	nvs_write(&fs, DISPLAY_ID, display_buf, 2000);
	nvs_write(&fs, DISPLAY2_ID, display_buf + 2000, 3000);
}


static void set_pixel(uint16_t x, uint16_t y, bool value) {
	uint16_t bitmapOffs = (y / 8) * DISPLAY_WIDTH + x;
	uint8_t bit = 7 - (y % 8);
	if (value) {
		display_buf[bitmapOffs] |= 1 << bit;
	} else {
		display_buf[bitmapOffs] &= ~(1 << bit);
	}
}

#define QR_VERSION (3)

static void draw_qr(const char *text, uint16_t x, uint16_t y, uint8_t scale) {
	QRCode qrcode;
	uint8_t qrcode_data[qrcode_getBufferSize(QR_VERSION)];
	qrcode_initText(&qrcode, qrcode_data, QR_VERSION, ECC_QUARTILE, text);

	for (uint8_t qr_y = 0; qr_y < qrcode.size; qr_y++) {
		for (uint8_t qr_x = 0; qr_x < qrcode.size; qr_x++) {
			for (uint8_t sx = 0; sx < scale; sx++) {
				for (uint8_t sy = 0; sy < scale; sy++) {
					set_pixel(x + qr_x * scale + sx, y + qr_y * scale + sy, !qrcode_getModule(&qrcode, qr_x, qr_y));
				}
			}
		}
	}
}

struct write_disp_data_req {
	u16_t pos:15;
  u8_t dirty:1;
  u8_t data[18];
} __packed;

static ssize_t write_disp_data(struct bt_conn *conn,
				const struct bt_gatt_attr *attr,
				const void *buf, u16_t len, u16_t offset,
				u8_t flags)
{
	const struct write_disp_data_req *req = buf;

	if (!len && len < 1) {
		return BT_GATT_ERR(BT_ATT_ERR_INVALID_ATTRIBUTE_LEN);
	}

  if (len == 1) {
    // This means: clear screen
    memset(&display_buf, *((u8_t*)buf), sizeof(display_buf));
  } else {
    memcpy(&display_buf[req->pos], req->data, len - 2);
    display_dirty = req->dirty;
  }

  display_set = true;

	return len;
}

static ssize_t read_battery_voltage_cb(struct bt_conn *conn,
				const struct bt_gatt_attr *attr,
				void *buf, u16_t len, u16_t offset)
{
	char *value = attr->user_data;

	sample_battery_voltage();
	sprintf(value, "%.2f", read_battery_voltage());

	return bt_gatt_attr_read(conn, attr, buf, len, offset, value, strlen(value));
}

char disp_char_buf[20] = {0};
char battery_voltage_buf[20] = {0};

static struct bt_gatt_attr disp_attrs[] = {
	BT_GATT_PRIMARY_SERVICE(BT_UUID_DISP),

	BT_GATT_CHARACTERISTIC(BT_UUID_DISP_DATA,
			       BT_GATT_CHRC_WRITE | BT_GATT_CHRC_INDICATE,
			       BT_GATT_PERM_WRITE, NULL, write_disp_data,
			       &disp_char_buf),
	BT_GATT_CUD("Display Buffer", BT_GATT_PERM_READ),

	BT_GATT_CHARACTERISTIC(BT_UUID_BATT_VOLTAGE,
			       BT_GATT_CHRC_READ,
			       BT_GATT_PERM_READ, read_battery_voltage_cb, NULL,
			       &battery_voltage_buf),
	BT_GATT_CUD("Battery Voltage", BT_GATT_PERM_READ),
};

static struct bt_gatt_service disp_svc = BT_GATT_SERVICE(disp_attrs);

static struct bt_conn_cb conn_callbacks = {
	.connected = connected,
	.disconnected = disconnected,
};

static const char* get_name_suffix() {
	static char name_suffix[7];
	bt_addr_le_t addr;
	size_t count = 1;
	bt_id_get(&addr, &count);
	sprintf(name_suffix, "%02x%02x%02x", addr.a.val[3], addr.a.val[4], addr.a.val[5]);
	return name_suffix;
}

static const char* get_qr_url() {
	static char url[36];
	sprintf(url, "https://go.urish.org/AC?b=%s", get_name_suffix());
	return url;
}

static void bt_ready(int err) {
	if (err) {
		LOG_ERR("Bluetooth init failed (err %d)", err);
		return;
	}

	LOG_INF("Bluetooth initialized");

	bt_conn_cb_register(&conn_callbacks);
	bt_gatt_service_register(&disp_svc);

	char deviceName[32];
	sprintf(deviceName, "BADGE-%s", get_name_suffix());
	err = bt_set_name(deviceName);
	if (err) {
		LOG_ERR("Failed to set device name (err %d)", err);
		return;
	}

	err = bt_le_adv_start(BT_LE_ADV_CONN_NAME, ad, ARRAY_SIZE(ad), NULL, 0);
	if (err) {
		LOG_ERR("Advertising failed to start (err %d)", err);
		return;
	}
	is_advertising = true;

	scanner_init();

	LOG_INF("Advertising successfully started\n");
	bluetooth_ready = true;
}

void init_drivers(void) {
	init_buttons();
	init_battery_voltage();
	init_led();
	init_neopixels();
	init_vibration_motor();
	init_storage();
	init_sound();
}

static void blast() {
	LOG_INF("Sending a blast packet...");
	colorgame_blast(is_advertising);
	k_sleep(250);
	if (is_advertising) {
		bt_le_adv_update_data(ad, ARRAY_SIZE(ad), NULL, 0);
	} else {
		bt_le_adv_stop();
	}
	k_sleep(1000);
	
}

void main(void) {
	LOG_INF("Starting app...\n");

	init_drivers();
	int err;
	err = bt_enable(bt_ready);
	if (err) {
		LOG_ERR("Bluetooth Failed to start (err %d)", err);
		return;
	}
	
	colorgame_init(&fs);
	sound_sanity_result = sound_sanity();

	vs1053_test(40, 500);
	breathe_led(1000);

	// Startup sequence: vibrate briefly and light LEDs
	write_neopixels_all(blue, true);
	write_vibration_motor(1);
	k_sleep(100);
	write_vibration_motor(0);

	k_sleep(200);
	write_vibration_motor(1);
	k_sleep(100);
	write_vibration_motor(0);
	write_neopixels_all(black, true);  

	// Display
	display = device_get_binding(DISPLAY_DRIVER);
	if (display == NULL) {
		LOG_ERR("Display device not found");
		return;
	}

	if (display_set_pixel_format(display, PIXEL_FORMAT_MONO10) != 0) {
		LOG_ERR("Failed to set required pixel format");
		return;
	}

  struct display_capabilities cfg;

	display_get_capabilities(display, &cfg);
  LOG_INF("Display: %d x %d", cfg.x_resolution, cfg.y_resolution);

	if (cfb_framebuffer_init(display)) {
		LOG_ERR("Framebuffer initialization failed!");
		return;
	}

	cfb_framebuffer_clear(display, true);

	display_blanking_on(display);

	u16_t rows;
	u8_t ppt;
	u8_t font_width;
	u8_t font_height;
	rows = cfb_get_display_parameter(display, CFB_DISPLAY_ROWS);
	ppt = cfb_get_display_parameter(display, CFB_DISPLAY_PPT);
	for (int idx = 0; idx < 42; idx++) {
		if (cfb_get_font_size(display, idx, &font_width, &font_height)) {
			break;
		}
		cfb_framebuffer_set_font(display, idx);
		LOG_INF("font width %d, font height %d\n",
		       font_width, font_height);
	}
	
	update_display();
	
	k_sleep(3000);

	memset(display_buf, 0xff, sizeof(display_buf));
	memcpy(display_buf, logo, sizeof(logo));
	draw_qr(get_qr_url(), 100, 6, 4);
	display_write(display, 0, 0, &desc, display_buf);

	bool qr_mode = false;
	int rc;
	while (1) {
		struct keyboard_event event;
		int ret = k_msgq_get(&keyboard_event_queue, &event, 500);

		if (!ret & event.pressed) {
			switch (event.button) {
				case LEFT_BUTTON:
					blast();
					break;

				case MIDDLE_BUTTON:
					qr_mode = !qr_mode;
					if(qr_mode) {
							memset(display_buf, 0xff, sizeof(display_buf));
							memcpy(display_buf, logo, sizeof(logo));
							draw_qr(get_qr_url(), 100, 6, 4);
							display_write(display, 0, 0, &desc, display_buf);
						err = bt_le_adv_start(BT_LE_ADV_CONN_NAME, ad, ARRAY_SIZE(ad), NULL, 0);
						is_advertising = true;
						if (err) {
							LOG_ERR("Advertising failed to start (err %d)", err);
						}
					} else {
						bt_le_adv_stop();
						is_advertising = false;
						rc = nvs_read(&fs, DISPLAY_ID, display_buf, 2000);
						if(rc <= 0) {
							LOG_ERR("cannot read display buf");
						} else {
							
							rc = nvs_read(&fs, DISPLAY2_ID, display_buf + 2000, 3000);
							if(rc <= 0) {
								LOG_ERR("cannot read display buf pt 2");
							}
							else {
								display_dirty = true;
								LOG_INF("showing display");
							}
						}
					}

					break;

				case RIGHT_BUTTON:
					bt_le_adv_stop();
					is_advertising = false;
					agenda_next();
					break;
			}
		}

    if (display_dirty) {
			display_write(display, 0, 0, &desc, display_buf);
      display_dirty = false;
    }
	}
}
```

## src/agenda.c
```c
#include <device.h>
#include <display/cfb.h>
#include <string.h>

extern struct device *display;
static s16_t agenda_index = 0;

static const char *agenda[] = {
    // Day 1
    "9:30am Signup & registration",
    "10:30am Opening session | Nir Krakowski",
    "11am What's going on with Aram? | Daniel Goldberg",
    "11:30am Aramcon badge | Uri Shaked",
    "12pm Lunch",
    "1pm [Infra] Public clouds IaaS internals | Liran Alon",
    "1pm [Startups] How to get the most from your investors | Michael Reitblat",
    "2:10pm [Startups] Options 101 | Amit Goldstein",
    "3:20pm [Infra] Autonomous vehicles | Uri Yacoby",
    "3:20pm [Startups] Case study: Guardicore | Pavel Gurvich",
    "4:30pm [Infra] CPU inside | Elad Raz",
    "4:30pm [Startups] Panel: acquisition behind the scenes | Danny Leshem",
    "6pm spaceil | Yariv Bash",
    "7pm Dinner",

    // Day 2
    "8:15am Breakfast",
    "9:10am [Code] Effective code reviews | Yaron Inger",
    "9:10am [Cyber] CTF riddles | Oded Margalit",
    "10:20am [Code] Thoughts about programming | Yaron Dinkin",
    "10:20am [Cyber] amdflaws | Ilia Luk-Zilberman",
    "11:30am [Code] Crazy bugs | Saar Raz",
    "11:30am [Cyber] Stackoveflow, the vulnerability marketplace | Danny Grander",
    "12:30pm Lunch",
    "1:30pm [Crypto] Bitcoin's mining market | Robert Parham",
    "1:30pm [Startups] From biotech to techbio | Omri Amirav Drory",
    "2:40pm [Crypto] Attacking blockchains | Idan Ofrat",
    "2:40pm [Cyber] Attacking neural networks | Yuval Weisglass",
    "3:50pm [Career] Long term investing | Danny Leshem",
    "3:50pm [Cyber] Hardware attacks for firmware dumping | Shachar Menashe",
    "4:50pm Closing session | Nir Krakowski",
};

const u16_t agenda_size = sizeof(agenda) / sizeof(agenda[0]);

static void display_agenda() {
  char line[128];
  strcpy(line, agenda[agenda_index]);
  char *space = strchr(line, ' ');
  space[0] = '\0';
  char *agenda_time = line;
  char *agenda_session = space + 1;
  char *pipe = strchr(agenda_session, '|');
  char *agenda_speaker = NULL;
  if (pipe) {
    pipe[0] = '\0';
    agenda_speaker = pipe + 1;
  }

  cfb_framebuffer_clear(display, true);
  cfb_print(display, agenda_time, 10, 0);
  cfb_print(display, agenda_session, 10, 32);
  if (agenda_speaker) {
    cfb_print(display, agenda_speaker, 10, 72);
  }
  cfb_framebuffer_finalize(display);
}

void agenda_prev() {
  agenda_index--;
  if (agenda_index < 0) {
    agenda_index = agenda_size - 1;
  }
  display_agenda();
}

void agenda_next() {
  agenda_index++;
  if (agenda_index >= agenda_size) {
    agenda_index = 0;
  }
  display_agenda();
}
```

## src/agenda.h
```c
#ifndef __AGENDA_H__
#define __AGENDA_H__

extern void agenda_prev();
extern void agenda_next();

#endif // __AGENDA_H__
```

## src/colorgame.c
```c
#include <logging/log.h>
LOG_MODULE_REGISTER(colorgame);
#include <stdlib.h>

#include <bluetooth/bluetooth.h>

#include "drivers/neopixels.h"
#include "drivers/vibration_motor.h"
#include "colorgame.h"

#define PACKET_VENDOR_ID (0x1337)
#define RSSI_THRESHOLD (-60)
#define BLAST_TIMEOUT (5000)

u32_t last_blast;

struct __attribute__((__packed__)) colorgame_packet
{
  u16_t vendor_id;
  u8_t r;
  u8_t g;
  u8_t b;
};

static const struct led_rgb colors[] = {
  //red
  {
    .r = 0x20,
    .g = 0,
    .b = 0
  },
  //green
  {
    .r = 0,
    .g = 0x20,
    .b = 0
  },
  //blue
  {
    .r = 0,
    .g = 0,
    .b = 0x20
  },
  // yellow
  {
    .r = 0x20,
    .g = 0x20,
    .b = 0
  },
  //purple
    {
    .r = 0x20,
    .g = 0,
    .b = 0x20
  },
  //cyan
    {
    .r = 0,
    .g = 0x20,
    .b = 0x20
  },

};


static struct led_rgb my_color;

void colorgame_packet_handler(void *buf, u8_t len, s8_t rssi)
{
  struct colorgame_packet *packet = buf;
  if (len >= sizeof(packet) && packet->vendor_id == PACKET_VENDOR_ID)
  {
    LOG_INF("Incoming blast, RSSI=%d - %s", rssi, rssi >= RSSI_THRESHOLD ? "accepted" : "rejected");
    if (rssi >= RSSI_THRESHOLD)
    {
      my_color.r = packet->r;
      my_color.g = packet->g;
      my_color.b = packet->b;
      pulse_vibration_motor(400);
      k_sleep(500);
      write_neopixels_all(my_color, true);
    }
  }
}

void colorgame_blast(bool is_advertising)
{
  const struct colorgame_packet data_packet = {
      .vendor_id = PACKET_VENDOR_ID,
      .r = my_color.r,
      .g = my_color.g,
      .b = my_color.b,
  };

  const struct bt_data ad[] = {
      BT_DATA(BT_DATA_MANUFACTURER_DATA, &data_packet, sizeof(data_packet)),
  };

  s32_t delta = k_uptime_get_32() - last_blast;
  if (delta < BLAST_TIMEOUT) {
    return;
  }

  if (is_advertising) {
    bt_le_adv_update_data(ad, ARRAY_SIZE(ad), NULL, 0);
  } else {
    bt_le_adv_start(BT_LE_ADV_CONN_NAME, ad, ARRAY_SIZE(ad), NULL, 0);
  }

  last_blast = k_uptime_get_32();
}

void colorgame_init()
{
  last_blast = k_uptime_get_32();
  u32_t index = sys_rand32_get() % (sizeof(colors) / sizeof(colors[0]));
  my_color = colors[index];
}
```

## src/colorgame.h
```c
#ifndef __COLORGAME_H__
#define __COLORGAME_H__

#include <zephyr/types.h>
#include <nvs/nvs.h>

void colorgame_packet_handler(void *buf, u8_t len, s8_t rssi);

void colorgame_blast(bool is_advertising);

void colorgame_init(struct nvs_fs * fs);

#endif // __COLORGAME_H__
```

## src/mesh.c
```c
#include <logging/log.h>
LOG_MODULE_REGISTER(mesh);

#include <zephyr.h>
#include <device.h>
#include <bluetooth/bluetooth.h>
#include <bluetooth/mesh.h>

#include "mesh.h"

#define MOD_LF 0x0000

#define GROUP_ADDR 0xc000
#define PUBLISHER_ADDR 0x000f

#define OP_VENDOR_BUTTON BT_MESH_MODEL_OP_3(0x00, BT_COMP_ID_LF)

static const u8_t net_key[16] = {
    0x01, 0x23, 0x45, 0x67, 0x89, 0xab, 0xcd, 0xef,
    0x01, 0x23, 0x45, 0x67, 0x89, 0xab, 0xcd, 0xef};
static const u8_t dev_key[16] = {
    0x01, 0x23, 0x45, 0x67, 0x89, 0xab, 0xcd, 0xef,
    0x01, 0x23, 0x45, 0x67, 0x89, 0xab, 0xcd, 0xef};
static const u8_t app_key[16] = {
    0x01, 0x23, 0x45, 0x67, 0x89, 0xab, 0xcd, 0xef,
    0x01, 0x23, 0x45, 0x67, 0x89, 0xab, 0xcd, 0xef};

static const u16_t net_idx;
static const u16_t app_idx;
static const u32_t iv_index;
static u8_t flags;
static u16_t addr = 0x0b0c;

static void heartbeat(u8_t hops, u16_t feat)
{
  LOG_INF("heartbeat, %d, %d", hops, feat);
}

static struct bt_mesh_cfg_srv cfg_srv = {
    .relay = BT_MESH_RELAY_ENABLED,
    .beacon = BT_MESH_BEACON_ENABLED,
    .frnd = BT_MESH_FRIEND_NOT_SUPPORTED,
    .default_ttl = 7,

    /* 3 transmissions with 20ms interval */
    .net_transmit = BT_MESH_TRANSMIT(2, 20),
    .relay_retransmit = BT_MESH_TRANSMIT(3, 20),

    .hb_sub.func = heartbeat,
};

static void vnd_button_pressed(struct bt_mesh_model *model,
                               struct bt_mesh_msg_ctx *ctx,
                               struct net_buf_simple *buf)
{
  LOG_INF("src 0x%04x val\n", ctx->addr);

  if (ctx->addr == bt_mesh_model_elem(model)->addr)
  {
    return;
  }

  LOG_INF("button pressed");
}

static const struct bt_mesh_model_op vnd_ops[] = {
    {OP_VENDOR_BUTTON, 0, vnd_button_pressed},
    BT_MESH_MODEL_OP_END,
};

static struct bt_mesh_model vnd_models[] = {
    BT_MESH_MODEL_VND(BT_COMP_ID_LF, MOD_LF, vnd_ops, NULL, NULL),
};

BT_MESH_HEALTH_PUB_DEFINE(health_pub, 0);

static struct bt_mesh_cfg_cli cfg_cli = {};

static void attention_on(struct bt_mesh_model *model)
{
  LOG_INF("attention_on()");
}

static void attention_off(struct bt_mesh_model *model)
{
  LOG_INF("attention_off()");
}

static const struct bt_mesh_health_srv_cb health_srv_cb = {
    .attn_on = attention_on,
    .attn_off = attention_off,
};

static struct bt_mesh_health_srv health_srv = {
    .cb = &health_srv_cb,
};

static struct bt_mesh_model root_models[] = {
    BT_MESH_MODEL_CFG_SRV(&cfg_srv),
    BT_MESH_MODEL_CFG_CLI(&cfg_cli),
    BT_MESH_MODEL_HEALTH_SRV(&health_srv, &health_pub),
};

static struct bt_mesh_elem elements[] = {
    BT_MESH_ELEM(0, root_models, vnd_models),
};

static const struct bt_mesh_comp comp = {
    .cid = BT_COMP_ID_LF,
    .elem = elements,
    .elem_count = ARRAY_SIZE(elements),
};

static void mesh_configure()
{
  /* Add Application Key */
  bt_mesh_cfg_app_key_add(net_idx, addr, net_idx, app_idx, app_key, NULL);

  /* Bind to vendor model */
  bt_mesh_cfg_mod_app_bind_vnd(net_idx, addr, addr, app_idx,
                               MOD_LF, BT_COMP_ID_LF, NULL);

  /* Bind to Health model */
  bt_mesh_cfg_mod_app_bind(net_idx, addr, addr, app_idx,
                           BT_MESH_MODEL_ID_HEALTH_SRV, NULL);

  /* Add model subscription */
  bt_mesh_cfg_mod_sub_add_vnd(net_idx, addr, addr, GROUP_ADDR,
                              MOD_LF, BT_COMP_ID_LF, NULL);
}

static const u8_t dev_uuid[16] = {0xdd, 0xdd};

static const struct bt_mesh_prov prov = {
    .uuid = dev_uuid,
};

void mesh_init()
{
  int err = bt_mesh_init(&prov, &comp);
  if (err)
  {
    LOG_ERR("Initializing mesh failed (err %d)\n", err);
    return;
  }
  err = bt_mesh_provision(net_key, net_idx, flags, iv_index, addr,
                          dev_key);
  if (err == -EALREADY)
  {
    LOG_INF("Using stored settings\n");
  }
  else if (err)
  {
    LOG_ERR("Provisioning failed (err %d)\n", err);
    return;
  }
  else
  {
    LOG_INF("Provisioning completed\n");
    mesh_configure();
  }
}
```

## src/mesh.h
```c
extern void mesh_init();
```

## src/scanner.c
```c
#include <logging/log.h>
LOG_MODULE_REGISTER(scanner);

#include <zephyr/types.h>

#include <bluetooth/bluetooth.h>
#include <bluetooth/hci.h>

#include "drivers/neopixels.h"
#include "colorgame.h"
#include "scanner.h"

static int counter = 0;

#define PACKET_VENDOR_ID (0xf00d)

struct __attribute__((__packed__)) control_packet
{
  u16_t vendor_id;
  u8_t r;
  u8_t g;
  u8_t b;
};

static void scan_cb(const bt_addr_le_t *addr, s8_t rssi, u8_t adv_type,
                    struct net_buf_simple *ad)
{
  counter++;

  while (ad->len > 1)
  {
    u8_t len = net_buf_simple_pull_u8(ad);
    u8_t type;

    /* Check for early termination */
    if (len == 0U)
    {
      return;
    }

    if (len > ad->len)
    {
      LOG_WRN("AD malformed");
      return;
    }

    type = net_buf_simple_pull_u8(ad);
    u8_t content_len = len - 1;
    struct control_packet *content = net_buf_simple_pull_mem(ad, content_len);

    if (type == BT_DATA_MANUFACTURER_DATA) {
      colorgame_packet_handler(content, content_len, rssi);
    }

    if (type == BT_DATA_MANUFACTURER_DATA &&
        content_len >= sizeof(struct control_packet) &&
        content->vendor_id == PACKET_VENDOR_ID)
    {
      LOG_INF("Control packet: R=%02x, G=%02x, B=%02x", content->r, content->g, content->b);
      const struct led_rgb color = {
          .r = content->r,
          .g = content->g,
          .b = content->b,
      };
      write_neopixels_all(color, true);
      return;
    }
  }
}

int scanner_init()
{
  static struct bt_le_scan_param scan_param = {
      .type = BT_HCI_LE_SCAN_PASSIVE,
      .filter_dup = BT_HCI_LE_SCAN_FILTER_DUP_DISABLE,
      .interval = 0x0010,
      .window = 0x0010,
  };

  int err = bt_le_scan_start(&scan_param, scan_cb);
  if (err)
  {
    LOG_ERR("Starting scanning failed (err %d)", err);
    return err;
  }

  return 0;
}
```

## src/scanner.h
```c
extern int scanner_init();
```
